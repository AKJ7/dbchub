VERSION ""

NS_ :

BS_:

BU_: ABS SAS

BO_ 512 WheelSpeeds: 8 ABS
 SG_ WheelSpeedFL : 0|16@1+ (0.01,0) [0|655] "km/h" SAS
 SG_ WheelSpeedFR : 16|16@1+ (0.01,0) [0|655] "km/h" SAS

BO_ 513 SteeringAngle: 4 SAS
 SG_ SteerAngle : 0|16@1- (0.1,0) [-780|780] "deg" ABS

CM_ BO_ 512 "Per-wheel speed measurements";
