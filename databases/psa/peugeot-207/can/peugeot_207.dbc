VERSION ""

NS_ :

BS_:
BU_:
BO_ 182 ECU1: 8 Vector__XXX
   SG_ GroundSpeed : 23|16@0+ (0.01,0) [0|220] "km/h" Vector__XXX
   SG_ EngineSpeed : 7|13@0+ (1,0) [0|7000] "rpm" Vector__XXX

BO_ 535 IPC: 8 Vector__XXX
   SG_ BacklightBrightness : 7|4@0+ (1,0) [0|15] "" Vector__XXX

BO_ 2147484001 ECU1: 8 Vector__XXX
   SG_ FuelLevel : 31|8@0+ (1,0) [0|100] "%" Vector__XXX

BO_ 2147483894 ECU1: 8 Vector__XXX
   SG_ EngineCoolantTemperature : 15|8@0+ (1,-40) [0|1] "degC" Vector__XXX
   SG_ Odometer : 23|24@0+ (0.1,0) [0|1] "km" Vector__XXX

CM_ BO_ 182 "Electronic Control Unit 1";
CM_ SG_ 182 GroundSpeed "Vehicle_ground_speed";
CM_ SG_ 182 EngineSpeed "Engine_speed";
CM_ BO_ 535 "Instrument Panel Cluster";
CM_ SG_ 535 BacklightBrightness "Backlight_brightness";
CM_ BO_ 2147484001 "Electronic Control Unit 1";
CM_ SG_ 2147484001 FuelLevel "Fuel_level";
CM_ BO_ 2147483894 "Electronic Control Unit 1";
CM_ SG_ 2147483894 EngineCoolantTemperature "Engine_coolant_temperature";
CM_ SG_ 2147483894 Odometer "Odometer";
BA_DEF_ BO_ "VFrameFormat" ENUM "StandardCAN","ExtendedCAN","reserved","J1939PG";
BA_DEF_ "DatabaseVersion" STRING ;
BA_DEF_ BO_ "GenMsgBackgroundColor" STRING ;
BA_DEF_ BO_ "GenMsgForegroundColor" STRING ;
BA_DEF_ BO_ "labelfilters" INT 0 0;
BA_DEF_ BO_ "filterlabeling" INT 0 0;
BA_DEF_ BO_ "filterlabeling" INT 0 0;
BA_DEF_DEF_ "VFrameFormat" "J1939PG";
BA_DEF_DEF_ "DatabaseVersion" "DEMO";
BA_DEF_DEF_ "GenMsgBackgroundColor" "#ffffff";
BA_DEF_DEF_ "GenMsgForegroundColor" "#000000";
BA_DEF_DEF_ "labelfilters" 1;
BA_DEF_DEF_ "filterlabeling" 1;
BA_DEF_DEF_ "filterlabeling" 1;
